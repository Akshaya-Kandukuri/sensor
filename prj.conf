## CMakeLists.txt
```
# SPDX-License-Identifier: Apache-2.0

cmake_minimum_required(VERSION 3.20.0)
find_package(Zephyr REQUIRED HINTS $ENV{ZEPHYR_BASE})
project(nt-button)

target_sources(app PRIVATE src/main.c src/sensor_hub_service.c)
# target_sources(app PRIVATE src/main.c)

# NORDIC SDK APP END
zephyr_library_include_directories(.)
```

## prj.conf
```kconfig
# Logger module
# Log data over the USB with a baud rate of 115200
CONFIG_LOG=y
CONFIG_LOG_BACKEND_UART=y
CONFIG_CBPRINTF_FP_SUPPORT=y # necessary for proper support of Logging with variables

# Button and LED library
CONFIG_DK_LIBRARY=y
CONFIG_BT_PERIPHERAL=y

# Bluetooth LE
# STEP 1 - Include the Bluetooth LE stack in your project
CONFIG_BT=y

# STEP 2 - Set the Bluetooth LE device name
CONFIG_BT_DEVICE_NAME="IIB-NT53-05"

# Configure Thingy:53 sensors
CONFIG_I2C=y
CONFIG_SENSOR=y
CONFIG_BME680=y
CONFIG_ADXL362=y

# Increase stack size for the main thread and System Workqueue
CONFIG_SYSTEM_WORKQUEUE_STACK_SIZE=2048
CONFIG_MAIN_STACK_SIZE=2048
```

## src/main.c
```c
// /*
//  * Copyright (c) 2016 Intel Corporation
//  *
//  * SPDX-License-Identifier: Apache-2.0
//  */

#include <src/main.h>
#include <src/sensor_hub_service.h>
#include <zephyr/types.h>
#include <stdio.h>
#include <stddef.h>
#include <string.h>
#include <errno.h>
#include <zephyr/sys/byteorder.h>
#include <zephyr/kernel.h>
#include <zephyr/logging/log.h>
#include <zephyr/drivers/gpio.h>
#include <soc.h>
#include <zephyr/sys/printk.h>
#include <zephyr/logging/log.h>
#include <zephyr/bluetooth/bluetooth.h>
#include <zephyr/bluetooth/hci.h>
#include <zephyr/bluetooth/uuid.h>
#include <zephyr/bluetooth/gatt.h>
#include <zephyr/bluetooth/gap.h>
#include <zephyr/settings/settings.h>
#include <dk_buttons_and_leds.h>

LOG_MODULE_REGISTER(NT53_05, LOG_LEVEL_DBG);

// define the macros for getting the device name and length of the device name
#define DEVICE_NAME CONFIG_BT_DEVICE_NAME
#define DEVICE_NAME_LEN (sizeof(DEVICE_NAME) - 1)

// macro for the company code (code of nordic semiconductors, https://www.bluetooth.com/wp-content/uploads/Files/Specification/HTML/Assigned_Numbers/out/en/Assigned_Numbers.pdf?v=1726749632991 page 210 and following)
#define COMPANY_ID_CODE 0x0059

// time in standby
#define SLEEP_TIME_MS   300

// /* getting the device tree node via the aliases */
#define LEDR_NODE DT_ALIAS(led0)
#define LEDG_NODE DT_ALIAS(led1)
#define LEDB_NODE DT_ALIAS(led2)
#define BT0_NODE DT_ALIAS(sw0)

// define data structure for custom data
typedef struct adv_mfg_data {
	uint16_t number_press;      /* Number of times Button 1 is pressed*/
} adv_mfg_data_type;

// // create a new instance of custom data with the id of nordic and 0 because the button has not been pressed yet
static adv_mfg_data_type adv_mfg_data = {0x00};

// advertisement data, sending the name (see prj.conf)
static const struct bt_data advertData[] = {
	BT_DATA_BYTES(BT_DATA_FLAGS, (BT_LE_AD_GENERAL | BT_LE_AD_NO_BREDR)),
	BT_DATA(BT_DATA_NAME_COMPLETE, DEVICE_NAME, DEVICE_NAME_LEN),
	BT_DATA(BT_DATA_MANUFACTURER_DATA,(unsigned char *)&adv_mfg_data, sizeof(adv_mfg_data))
};

// https address of nordic academy
static unsigned char url_data[] ={0x17,'/','/','a','c','a','d','e','m','y','.',
                                 'n','o','r','d','i','c','s','e','m','i','.',
                                 'c','o','m'};

// response date for bluetooth advertisement (sending the nordic semi URL)
static const struct bt_data responseData[] = {
	BT_DATA(BT_DATA_URI, url_data,sizeof(url_data))
};

//parametrize advetisement
static struct bt_le_adv_param *adv_param =
	BT_LE_ADV_PARAM(BT_LE_ADV_OPT_CONNECTABLE | BT_LE_ADV_OPT_USE_IDENTITY,
		BT_GAP_ADV_FAST_INT_MIN_1, /* 0x30 units, 48 units, 30ms */
		BT_GAP_ADV_FAST_INT_MAX_1, /* 0x60 units, 96 units, 60ms */
		NULL);	// peer address for directed advertising

// connected and disconnected callbacks
struct bt_conn *my_conn = NULL;
struct bt_conn_cb connection_callbacks = {
    .connected              = on_connected,
    .disconnected           = on_disconnected,
};

// // get the io specifications by using their nodes
static const struct gpio_dt_spec ledR = GPIO_DT_SPEC_GET(LEDR_NODE, gpios);
static const struct gpio_dt_spec ledG = GPIO_DT_SPEC_GET(LEDG_NODE, gpios);
static const struct gpio_dt_spec ledB = GPIO_DT_SPEC_GET(LEDB_NODE, gpios);
static const struct gpio_dt_spec button0 = GPIO_DT_SPEC_GET(BT0_NODE, gpios);

// sensors
static const struct device *bme688SensorDev = DEVICE_DT_GET_ONE(bosch_bme680);	// Temperature, Humidity, Pressure, Air Quality
static const struct device *adxl362 = DEVICE_DT_GET_ONE(adi_adxl362);			// 3-Axis Accelerometer

// status variables
bool isConnected = false;

int main(void)
{
	LOG_INF("Start application...\n");
	int err;

	// initialize the IOs and bluetooth
	err = initButtonsLEDs();
	err = initBluetooth();

	// register callbacks for connected and disconnected
	bt_conn_cb_register(&connection_callbacks);

	LOG_INF("Advertising successfully started\n");

	while (true) {
		// read data

		sample_and_update_all_sensor_values(bme688SensorDev,adxl362);

		// let the red LED blink
		if (isConnected == false)
		{
			err = gpio_pin_toggle_dt(&ledR);
		}
		else
		{
			err = gpio_pin_set_dt(&ledR, 0);
		}
		
		if (err < 0) 
		{
			return err;
		}

		k_msleep(SLEEP_TIME_MS);
	}
	return 0;
}

// if the button is pressed, increase the counter and send it over BLE
void button_changed(uint32_t button_state, uint32_t has_changed)
{
	// if (has_changed & button_state & USER_BUTTON) {	// if the button has been pressed
	// 	adv_mfg_data.number_press += 1;	// increase the counter
	// 	bt_le_adv_update_data(advertData, ARRAY_SIZE(advertData),	// send the new data over BLE
	// 		      responseData, ARRAY_SIZE(responseData));
	// }
}

int initButtonsLEDs()
{
	int result;

	// init Button and leds
	result = gpio_pin_configure_dt(&button0, GPIO_INPUT);
	result = dk_buttons_init(NULL);
	if (result < 0) {
		return result;
	}

	result = dk_leds_init();
	if (result) {
		LOG_ERR("LEDs init failed (err %d)\n", result);
		return result;
	}

	result = gpio_pin_set_dt(&ledR, 0);
	result = gpio_pin_set_dt(&ledG, 0);
	result = gpio_pin_set_dt(&ledB, 0);
	return result;
}

// Initialize Bluetooth
int initBluetooth()
{
	int err;
	err = bt_enable(NULL);
	if (err) {
		LOG_ERR("Bluetooth init failed (err %d)\n", err);
		return err;
	}
	LOG_INF("Bluetooth initialized\n");

	// start
	err = bt_le_adv_start(adv_param, advertData, ARRAY_SIZE(advertData),
			      responseData, ARRAY_SIZE(responseData));
	if (err) {
		LOG_ERR("Advertising failed to start (err %d)\n", err);
		return err;
	}
	return 0;
}

// If the BLE is connected, enable the green LED
void on_connected(struct bt_conn *conn, uint8_t err)
{
	int internalError;
    if (err) {
        LOG_ERR("Connection error %d", err);
        return;
    }
    LOG_INF("Connected");
    my_conn = bt_conn_ref(conn);
	isConnected = true;
	internalError = gpio_pin_set_dt(&ledG, 1);
	if (internalError < 0)
	{
		LOG_ERR("LED Error %d", internalError);
	}
}

// If the BLE is connected, disable the green LED
void on_disconnected(struct bt_conn *conn, uint8_t reason)
{
    LOG_INF("Disconnected. Reason %d", reason);
    bt_conn_unref(my_conn);
	isConnected = false;
	int internalError;
	internalError = gpio_pin_set_dt(&ledG, 0);
	if (internalError < 0)
	{
		LOG_ERR("LED Error %d", internalError);
	}
}

int sample_and_update_all_sensor_values(const struct device *bme688Dev, const struct device *adxl362)
{
    int err;
    struct sensor_value temperature_value;
    struct sensor_value pressure_value;
    struct sensor_value humidity_value;
	struct sensor_value accelerationX;
    struct sensor_value accelerationY;
    struct sensor_value accelerationZ;
	LOG_DBG("Reading sensor values");
     
    //Trigger sampling of BME688 sensor
    err = sensor_sample_fetch(bme688Dev);
    if(err < 0)
    {
		LOG_ERR("Failed to collect samples from bme688. Error value: %d\n", err);
        return err;
    }
 
    //Collect temperature sample and update characteristic
    err = sensor_channel_get(bme688Dev, SENSOR_CHAN_AMBIENT_TEMP, &temperature_value);
    if(err<0)
    {
		LOG_ERR("Failed to fetch temperature sample. Error value: %d\n", err);
        return err;
    }
	// double fTemperature = (double)temperature_value.val1 + (double)temperature_value.val1*1E-6;
	double fTemperature = temperature_value.val1 + temperature_value.val2 * 1E-6;
	LOG_DBG("Temperature: %f", fTemperature);
	if (my_conn)
		sensor_hub_update_temperature(my_conn, &fTemperature, sizeof(fTemperature));
	
 
    //Collect pressure sample and update characteristic
    err = sensor_channel_get(bme688Dev, SENSOR_CHAN_PRESS, &pressure_value);
    if(err<0)
    {
        LOG_ERR("Failed to fetch pressure sample. Error value:  %d\n", err);
        return err;
    }
	double fPressure = pressure_value.val1 + pressure_value.val2 * 1E-6;
	LOG_DBG("Pressure: %f", fPressure);
	if (my_conn)
    	sensor_hub_update_pressure(my_conn, &fPressure, sizeof(fPressure));
 
    //Collect humidity sample and update characteristic
    err = sensor_channel_get(bme688Dev, SENSOR_CHAN_HUMIDITY, &humidity_value);
    if(err)
    {
        LOG_ERR("Failed to fetch humidity sample. Error value: %d\n", err);
        return err;
    }
	double fHumidity = humidity_value.val1 + humidity_value.val2 * 1E-6;
	LOG_DBG("Humidity: %f", fHumidity);
    if (my_conn)
		sensor_hub_update_humidity(my_conn, &fHumidity, sizeof(fHumidity));
 
	// Get acceleration values
	err = sensor_sample_fetch(adxl362);
	if(err < 0)
    {
		LOG_ERR("Failed to collect samples from adxl362. Error value: %d\n", err);
        return err;
    }

	// X acceleration
	err = sensor_channel_get(adxl362, SENSOR_CHAN_ACCEL_X, &accelerationX);
    if(err)
    {
        LOG_ERR("Failed to fetch X acceleration sample. Error value: %d\n", err);
        return err;
    }
	double fXAccel = accelerationX.val1 + accelerationX.val2 * 1E-6;
	LOG_DBG("X acceleration: %f", fXAccel);
	if (my_conn)
		sensor_hub_update_xAcceleration(my_conn, &fXAccel, sizeof(fXAccel));

	// Y acceleration
	err = sensor_channel_get(adxl362, SENSOR_CHAN_ACCEL_Y, &accelerationY);
    if(err)
    {
        LOG_ERR("Failed to fetch Y acceleration sample. Error value: %d\n", err);
        return err;
    }
	double fYAccel = accelerationY.val1 + accelerationY.val2 * 1E-6;
	LOG_DBG("Y acceleration: %f", fYAccel);
	if (my_conn)
		sensor_hub_update_yAcceleration(my_conn, &fYAccel, sizeof(fYAccel));

	// Z acceleration
	err = sensor_channel_get(adxl362, SENSOR_CHAN_ACCEL_Z, &accelerationZ);
    if(err)
    {
        LOG_ERR("Failed to fetch Z acceleration sample. Error value: %d\n", err);
        return err;
    }
	double fZAccel = accelerationZ.val1 + accelerationZ.val2 * 1E-6;
	LOG_DBG("Z acceleration: %f", fZAccel);
	if (my_conn)
		sensor_hub_update_zAcceleration(my_conn, &fZAccel, sizeof(fZAccel));


    return err;
}
```

## src/main.h
```c
#include <stdint.h>
#include <zephyr/bluetooth/conn.h>
#include <zephyr/drivers/sensor.h>

int initButtonsLEDs();
int initBluetooth();
void on_connected(struct bt_conn *conn, uint8_t err);
void on_disconnected(struct bt_conn *conn, uint8_t reason);
int sample_and_update_all_sensor_values(const struct device *bme688Dev, const struct device *adxl362);
```

## src/sensor_hub_service.c
```c
// sensor_hub_service.c
 
#include <zephyr/types.h>
#include <stddef.h>
#include <string.h>
#include <errno.h>
#include <zephyr/sys/printk.h>
#include <zephyr/sys/byteorder.h>
#include <zephyr/kernel.h>
#include <soc.h>
 
#include <zephyr/bluetooth/bluetooth.h>
#include <zephyr/bluetooth/hci.h>
#include <zephyr/bluetooth/conn.h>
#include <zephyr/bluetooth/uuid.h>
#include <zephyr/bluetooth/addr.h>
#include <zephyr/bluetooth/gatt.h>
 
#include "sensor_hub_service.h"

// environmental sensor data
#define BT_UUID_SENSOR_ENV              BT_UUID_DECLARE_128(SENSOR_HUB_ENV_SERVICE_UUID)
#define BT_UUID_SENSOR_ENV_TEMP         BT_UUID_DECLARE_128(TEMP_CHARACTERISTIC_UUID)
#define BT_UUID_SENSOR_ENV_PRESSURE     BT_UUID_DECLARE_128(PRESSURE_CHARACTERISTIC_UUID)
#define BT_UUID_SENSOR_ENV_HUMIDITY     BT_UUID_DECLARE_128(HUMIDITY_CHARACTERISTIC_UUID)

// positioning sensor data
#define BT_UUID_SENSOR_POS              BT_UUID_DECLARE_128(SENSOR_HUB_POS_SERVICE_UUID)
#define BT_UUID_SENSOR_POS_XACC         BT_UUID_DECLARE_128(XACCELERATION_CHARACTERISTIC_UUID)
#define BT_UUID_SENSOR_POS_YACC         BT_UUID_DECLARE_128(YACCELERATION_CHARACTERISTIC_UUID)
#define BT_UUID_SENSOR_POS_ZACC         BT_UUID_DECLARE_128(ZACCELERATION_CHARACTERISTIC_UUID)
 
/*This function is called whenever the Client Characteristic Control Descriptor (CCCD) has been
changed by the GATT client, for each of the characteristics*/
void on_cccd_changed(const struct bt_gatt_attr *attr, uint16_t value)
{
    ARG_UNUSED(attr);
    switch(value)
    {
        case BT_GATT_CCC_NOTIFY:
            // Start sending stuff!
            break;
         
        case 0:
            // Stop sending stuff
            break;
 
        default:
            printk("Error, CCCD has been set to an invalid value");    
    }
}
 
//Sensor hub Service Declaration and Registration
BT_GATT_SERVICE_DEFINE(sensor_env,
    BT_GATT_PRIMARY_SERVICE(BT_UUID_SENSOR_ENV),
     
    BT_GATT_CHARACTERISTIC(BT_UUID_SENSOR_ENV_TEMP,
                    BT_GATT_CHRC_NOTIFY,
                    BT_GATT_PERM_READ,
                    NULL, NULL, NULL),
    BT_GATT_CCC(on_cccd_changed, BT_GATT_PERM_READ | BT_GATT_PERM_WRITE),
     
    BT_GATT_CHARACTERISTIC(BT_UUID_SENSOR_ENV_PRESSURE,
                    BT_GATT_CHRC_NOTIFY,
                    BT_GATT_PERM_READ,
                    NULL, NULL, NULL),
    BT_GATT_CCC(on_cccd_changed, BT_GATT_PERM_READ | BT_GATT_PERM_WRITE),
 
    BT_GATT_CHARACTERISTIC(BT_UUID_SENSOR_ENV_HUMIDITY,
                    BT_GATT_CHRC_NOTIFY,
                    BT_GATT_PERM_READ,
                    NULL, NULL, NULL),
    BT_GATT_CCC(on_cccd_changed, BT_GATT_PERM_READ | BT_GATT_PERM_WRITE)
);

BT_GATT_SERVICE_DEFINE(sensor_pos,
    BT_GATT_PRIMARY_SERVICE(BT_UUID_SENSOR_POS),
     
    BT_GATT_CHARACTERISTIC(BT_UUID_SENSOR_POS_XACC,
                    BT_GATT_CHRC_NOTIFY,
                    BT_GATT_PERM_READ,
                    NULL, NULL, NULL),
    BT_GATT_CCC(on_cccd_changed, BT_GATT_PERM_READ | BT_GATT_PERM_WRITE),
     
    BT_GATT_CHARACTERISTIC(BT_UUID_SENSOR_POS_YACC,
                    BT_GATT_CHRC_NOTIFY,
                    BT_GATT_PERM_READ,
                    NULL, NULL, NULL),
    BT_GATT_CCC(on_cccd_changed, BT_GATT_PERM_READ | BT_GATT_PERM_WRITE),
 
    BT_GATT_CHARACTERISTIC(BT_UUID_SENSOR_POS_ZACC,
                    BT_GATT_CHRC_NOTIFY,
                    BT_GATT_PERM_READ,
                    NULL, NULL, NULL),
    BT_GATT_CCC(on_cccd_changed, BT_GATT_PERM_READ | BT_GATT_PERM_WRITE)
);
 
/* The below functions send a notification to a GATT client with the provided data,
given that the CCCD has been set to Notify (0x1) */
void sensor_hub_update_temperature(struct bt_conn *conn, const double *data, uint16_t len)
{
    const struct bt_gatt_attr *attr = &sensor_env.attrs[2];
 
    struct bt_gatt_notify_params params =
    {
        .uuid   = BT_UUID_SENSOR_ENV_TEMP,
        .attr   = attr,
        .data   = data,
        .len    = len,
        .func   = NULL
    };
 
    if(bt_gatt_is_subscribed(conn, attr, BT_GATT_CCC_NOTIFY))
    {
        // Send the notification
        if(bt_gatt_notify_cb(conn, &params))
        {
            printk("Error, unable to send notification\n");
        }
    }
    else
    {
        printk("Warning, notification not enabled for temperature characteristic\n");
    }
}
 
void sensor_hub_update_pressure(struct bt_conn *conn, const double *data, uint16_t len)
{
    const struct bt_gatt_attr *attr = &sensor_env.attrs[5];
 
    struct bt_gatt_notify_params params =
    {
        .uuid   = BT_UUID_SENSOR_ENV_PRESSURE,
        .attr   = attr,
        .data   = data,
        .len    = len,
        .func   = NULL
    };
 
    if(bt_gatt_is_subscribed(conn, attr, BT_GATT_CCC_NOTIFY))
    {
        // Send the notification
        if(bt_gatt_notify_cb(conn, &params))
        {
            printk("Error, unable to send notification\n");
        }
    }
    else
    {
        printk("Warning, notification not enabled for pressure characteristic\n");
    }
}
 
void sensor_hub_update_humidity(struct bt_conn *conn, const double *data, uint16_t len)
{
    const struct bt_gatt_attr *attr = &sensor_env.attrs[8];
 
    struct bt_gatt_notify_params params =
    {
        .uuid   = BT_UUID_SENSOR_ENV_HUMIDITY,
        .attr   = attr,
        .data   = data,
        .len    = len,
        .func   = NULL
    };
 
    if(bt_gatt_is_subscribed(conn, attr, BT_GATT_CCC_NOTIFY))
    {
        // Send the notification
        if(bt_gatt_notify_cb(conn, &params))
        {
            printk("Error, unable to send notification\n");
        }
    }
    else
    {
        printk("Warning, notification not enabled for humidity characteristic\n");
    }
}

void sensor_hub_update_xAcceleration(struct bt_conn *conn, const double *data, uint16_t len)
{
    const struct bt_gatt_attr *attr = &sensor_pos.attrs[2];
 
    struct bt_gatt_notify_params params =
    {
        .uuid   = BT_UUID_SENSOR_POS_XACC,
        .attr   = attr,
        .data   = data,
        .len    = len,
        .func   = NULL
    };
 
    if(bt_gatt_is_subscribed(conn, attr, BT_GATT_CCC_NOTIFY))
    {
        // Send the notification
        if(bt_gatt_notify_cb(conn, &params))
        {
            printk("Error, unable to send notification\n");
        }
    }
    else
    {
        printk("Warning, notification not enabled for x acceleration characteristic\n");
    }
}

void sensor_hub_update_yAcceleration(struct bt_conn *conn, const double *data, uint16_t len)
{
    const struct bt_gatt_attr *attr = &sensor_pos.attrs[5];
 
    struct bt_gatt_notify_params params =
    {
        .uuid   = BT_UUID_SENSOR_POS_YACC,
        .attr   = attr,
        .data   = data,
        .len    = len,
        .func   = NULL
    };
 
    if(bt_gatt_is_subscribed(conn, attr, BT_GATT_CCC_NOTIFY))
    {
        // Send the notification
        if(bt_gatt_notify_cb(conn, &params))
        {
            printk("Error, unable to send notification\n");
        }
    }
    else
    {
        printk("Warning, notification not enabled for x acceleration characteristic\n");
    }
}

void sensor_hub_update_zAcceleration(struct bt_conn *conn, const double *data, uint16_t len)
{
    const struct bt_gatt_attr *attr = &sensor_pos.attrs[8];
 
    struct bt_gatt_notify_params params =
    {
        .uuid   = BT_UUID_SENSOR_POS_ZACC,
        .attr   = attr,
        .data   = data,
        .len    = len,
        .func   = NULL
    };
 
    if(bt_gatt_is_subscribed(conn, attr, BT_GATT_CCC_NOTIFY))
    {
        // Send the notification
        if(bt_gatt_notify_cb(conn, &params))
        {
            printk("Error, unable to send notification\n");
        }
    }
    else
    {
        printk("Warning, notification not enabled for x acceleration characteristic\n");
    }
}
```

## src/sensor_hub_service.h
```c
// sensor_hub_service.h
 
#include <stddef.h>
#include <string.h>
#include <errno.h>
#include <zephyr/kernel.h>
#include <zephyr/types.h>
#include <soc.h>
 
#include <zephyr/bluetooth/bluetooth.h>
#include <zephyr/bluetooth/hci.h>
#include <zephyr/bluetooth/conn.h>
#include <zephyr/bluetooth/uuid.h>
#include <zephyr/bluetooth/gatt.h>
 
//Declaration of custom GATT service and characteristics UUIDs
#define SENSOR_HUB_ENV_SERVICE_UUID \
    BT_UUID_16_ENCODE(0x181a)
    //BT_UUID_128_ENCODE(0xa5b46352, 0x9d13, 0x479f, 0x9fcb, 0x3dcdf0a13f4d)
 
#define TEMP_CHARACTERISTIC_UUID \
    BT_UUID_16_ENCODE(0x2a6e)
    //BT_UUID_128_ENCODE(0x506a55c4, 0xb5e7, 0x46fa, 0x8326, 0x8acaeb1189eb)
 
#define PRESSURE_CHARACTERISTIC_UUID \
    BT_UUID_16_ENCODE(0x2a6d)
    //BT_UUID_128_ENCODE(0x51838aff, 0x2d9a, 0xb32a, 0xb32a, 0x8187e41664ba)
 
#define HUMIDITY_CHARACTERISTIC_UUID \
    BT_UUID_16_ENCODE(0x2a6f)
    //BT_UUID_128_ENCODE(0x753e3050, 0xdf06, 0x4b53, 0xb090, 0x5e1d810c4383)

#define SENSOR_HUB_POS_SERVICE_UUID \
    BT_UUID_16_ENCODE(0x1821)

#define XACCELERATION_CHARACTERISTIC_UUID \
    BT_UUID_128_ENCODE(0x506a55c4, 0xb5e7, 0x46fa, 0x8326, 0x8acaeb1189eb)

#define YACCELERATION_CHARACTERISTIC_UUID \
    BT_UUID_128_ENCODE(0x51838aff, 0x2d9a, 0xb32a, 0xb32a, 0x8187e41664ba)

#define ZACCELERATION_CHARACTERISTIC_UUID \
    BT_UUID_128_ENCODE(0x753e3050, 0xdf06, 0x4b53, 0xb090, 0x5e1d810c4383)
 
void sensor_hub_update_temperature(struct bt_conn *conn, const double *data, uint16_t len);
void sensor_hub_update_humidity(struct bt_conn *conn, const double *data, uint16_t len);
void sensor_hub_update_pressure(struct bt_conn *conn, const double *data, uint16_t len);
void sensor_hub_update_xAcceleration(struct bt_conn *conn, const double *data, uint16_t len);
void sensor_hub_update_yAcceleration(struct bt_conn *conn, const double *data, uint16_t len);
void sensor_hub_update_zAcceleration(struct bt_conn *conn, const double *data, uint16_t len);
```
